/*
 * cmd_system.c -- serial command handlers: *IDN?, BOOT, QSPI:ID?, QSPI:SELFtest.
 * Split out of the old single commands.c (2026-09-29); the handlers are
 * unchanged. See commands.h for the file map.
 */
#include "commands.h"
#include "cmd_common.h"
#include "ctrlr_config.h"
#include "boot_jump.h"
#include "qspi_test.h"
#include "nvstore.h"
#include "git_version.h"
#include "device_identity.h"
#include "mcu.h"
#include "state_machine.h"
#include <stdio.h>
#include <stdlib.h>
#include <string.h>

/* --------------------------------------------------------------------------
 * Identification / system
 * -------------------------------------------------------------------------- */

void cmd_idn(uart_instance_t *inst, char *args)
{
    char buf[160];
    char idTag[64];
    (void)args;

    /* Board + firmware identity in one line, matching the sibling
       PFM-STM32G474 project's *IDN convention (OK <value>, space-
       separated fields) -- see ctrlr_config.h for the constants.

       4th field, FW_GIT_COMMIT (added 2026-09-29, ported from
       WHAM-XREX-PFMG474): exactly which git commit THIS firmware was
       built from, so a host can always tell what is really running on a
       board. A `-dirty` suffix flags a build made with uncommitted
       changes. Generated by python/gen_git_version.py (run by
       python/wham_build.py) into build/generated/git_version.h. */
    /* Last field (2026-10-07): which physical board this is -- the serial
       (SN=UNSET until one is provisioned) and the MCU's factory unique ID
       (device_identity.h). Appended at the end so every parser that reads the
       earlier fields by position is unaffected. */
    (void)DeviceIdentity_FormatTag(idTag, sizeof(idTag));
    snprintf(buf, sizeof(buf), "OK %s %s %s %s%s %s\r\n",
             HW_BOARD_NAME, HW_BOARD_REV, FW_VERSION_STRING,
             FW_GIT_COMMIT, (FW_GIT_DIRTY != 0U) ? "-dirty" : "", idTag);
    uart_send(inst, buf);
}

#if (BOOT_JUMP_FEATURE_ENABLED != 0)
void cmd_boot(uart_instance_t *inst, char *args)
{
    (void)args;

    /* Refused while ARMED or FIRING (ERR 13): resetting into the ROM
       bootloader under load would drop the outputs uncontrolled. Allowed in
       IDLE and FAULT (a faulted board may need new firmware). */
    if ((SM_GetState() == SM_STATE_ARMED) || (SM_GetState() == SM_STATE_FIRING))
    {
        Scpi_SendErr(inst, ERR_INVALID_STATE, "BOOT refused while ARMED or FIRING -- DISARM first");
        return;
    }

    /* uart_send() is blocking (HAL_UART_Transmit with HAL_MAX_DELAY), so
       this ACK is guaranteed to be fully on the wire before
       BootJump_RequestBootloader() resets the MCU below -- the operator
       (or a flashing script) sees "OK ENTERING BOOTLOADER" before the
       link drops. */
    uart_send(inst, "OK ENTERING BOOTLOADER\r\n");

    BootJump_RequestBootloader();
    /* Never returns. */
}
#endif /* BOOT_JUMP_FEATURE_ENABLED */

#if (QSPI_TEST_FEATURE_ENABLED != 0)
/* --------------------------------------------------------------------------
 * QSPI:ID?
 *
 * QUADSPI connectivity test against the W25Q128JVS wired to
 * PE12-PE15/PB10-PB11 (docs/pin_mapping_v4.csv) -- issues the flash's
 * standard JEDEC Read ID instruction (0x9F, plain 1-line mode, no Quad
 * Enable required) via QspiTest_ReadId() (qspi_test.h) and reports the
 * 3 raw bytes (Manufacturer, Memory Type, Capacity) as space-separated
 * uppercase hex, e.g. "OK EF 40 18" for a healthy Winbond part --
 * compare against the W25Q128JVS datasheet's own JEDEC ID table rather
 * than trusting any specific expected value hardcoded here (none is;
 * this command reports what the chip actually says, nothing assumed).
 * ERR 7 on any HAL_QSPI command/receive failure or timeout (e.g. no
 * chip present, a wiring fault, or the bus wedged) -- see
 * QspiTest_ReadId()'s own doc comment for exactly what that call does
 * and does not verify.
 * -------------------------------------------------------------------------- */
void cmd_qspi_id(uart_instance_t *inst, char *args)
{
    uint8_t id[3];
    char buf[32];
    (void)args;

    if (QspiTest_ReadId(id) == 0U)
    {
        Scpi_SendErr(inst, ERR_QSPI_FAILED, "QUADSPI command failed or timed out");
        return;
    }

    snprintf(buf, sizeof(buf), "OK %02X %02X %02X\r\n",
             (unsigned int)id[0], (unsigned int)id[1], (unsigned int)id[2]);
    uart_send(inst, buf);
}
/* --------------------------------------------------------------------------
 * QSPI:SELFtest
 *
 * Bench proof of the external-flash storage driver (nvstore.h) against the
 * real W25Q128JVS, added 2026-09-29 before anything is built on top of it.
 * An action, not a query (it erases and programs), so no '?'. Works only on
 * the reserved scratch sector (NVSTORE_SCRATCH_ADDR, last sector of the
 * chip) and leaves it erased. IDLE only: a sector erase blocks the main loop
 * (serial link included) for tens of milliseconds.
 *
 * Steps: read the three status registers; erase the sector (the driver
 * checks it reads back blank); program a 300-byte pattern that starts
 * mid-page and crosses a 256-byte page boundary; read it back and compare;
 * read the WHOLE sector and check every byte outside the pattern is still
 * 0xFF (catches a page program that wrapped around inside its page and
 * clobbered earlier bytes); erase again.
 *
 * Reply: "OK PASS sr=<SR1>,<SR2>,<SR3> erase=<ms> prog=<ms> read=<ms>" (hex
 * status registers; times from the 1 ms tick, so +-1 ms), or
 * "ERR 7 selftest <step>: <reason>" naming the first step that failed.
 * ERR 13 if not IDLE.
 * -------------------------------------------------------------------------- */
#define SELFTEST_PATTERN_OFFSET   (200U)   /* 200..499: crosses the 256-byte page boundary */
#define SELFTEST_PATTERN_LEN      (300U)
#define SELFTEST_READ_CHUNK       (256U)

static uint8_t SelftestPatternByte(uint32_t i)
{
    return (uint8_t)((i * 7U) + 0x5AU);
}

static void SelftestFail(uart_instance_t *inst, const char *step, nvstore_status_t st)
{
    char msg[64];

    snprintf(msg, sizeof(msg), "selftest %s: %s", step, NvStore_StatusText(st));
    Scpi_SendErr(inst, ERR_QSPI_FAILED, msg);
}

void cmd_qspi_selftest(uart_instance_t *inst, char *args)
{
    uint8_t pattern[SELFTEST_PATTERN_LEN];
    uint8_t chunk[SELFTEST_READ_CHUNK];
    uint8_t sr[3];
    uint32_t t0;
    uint32_t eraseMs;
    uint32_t progMs;
    uint32_t readMs;
    char buf[96];
    nvstore_status_t st;
    (void)args;

    if (SM_GetState() != SM_STATE_IDLE)
    {
        Scpi_SendErr(inst, ERR_INVALID_STATE, "QSPI:SELFtest only in IDLE");
        return;
    }

    if ((st = NvStore_ReadStatusRegs(sr)) != NVSTORE_OK)
    {
        SelftestFail(inst, "status", st);
        return;
    }

    t0 = Mcu_GetTickMs();
    if ((st = NvStore_EraseSector(NVSTORE_SCRATCH_ADDR)) != NVSTORE_OK)
    {
        SelftestFail(inst, "erase", st);
        return;
    }
    eraseMs = Mcu_GetTickMs() - t0;

    for (uint32_t i = 0U; i < SELFTEST_PATTERN_LEN; i++)
    {
        pattern[i] = SelftestPatternByte(i);
    }
    t0 = Mcu_GetTickMs();
    if ((st = NvStore_Program(NVSTORE_SCRATCH_ADDR + SELFTEST_PATTERN_OFFSET, pattern,
                              SELFTEST_PATTERN_LEN)) != NVSTORE_OK)
    {
        SelftestFail(inst, "program", st);
        return;
    }
    progMs = Mcu_GetTickMs() - t0;

    /* Read the whole sector back, independently of the driver's own
       verify: the pattern where it belongs, 0xFF everywhere else. */
    t0 = Mcu_GetTickMs();
    for (uint32_t off = 0U; off < NVSTORE_SECTOR_BYTES; off += SELFTEST_READ_CHUNK)
    {
        if ((st = NvStore_Read(NVSTORE_SCRATCH_ADDR + off, chunk, SELFTEST_READ_CHUNK)) != NVSTORE_OK)
        {
            SelftestFail(inst, "read", st);
            return;
        }
        for (uint32_t i = 0U; i < SELFTEST_READ_CHUNK; i++)
        {
            uint32_t pos = off + i;
            uint8_t want = 0xFFU;

            if (pos >= SELFTEST_PATTERN_OFFSET && pos < (SELFTEST_PATTERN_OFFSET + SELFTEST_PATTERN_LEN))
            {
                want = SelftestPatternByte(pos - SELFTEST_PATTERN_OFFSET);
            }
            if (chunk[i] != want)
            {
                snprintf(buf, sizeof(buf), "selftest compare: offset %u is %02X, expected %02X",
                         (unsigned int)pos, (unsigned int)chunk[i], (unsigned int)want);
                Scpi_SendErr(inst, ERR_QSPI_FAILED, buf);
                return;
            }
        }
    }
    readMs = Mcu_GetTickMs() - t0;

    if ((st = NvStore_EraseSector(NVSTORE_SCRATCH_ADDR)) != NVSTORE_OK)
    {
        SelftestFail(inst, "final erase", st);
        return;
    }

    snprintf(buf, sizeof(buf), "OK PASS sr=%02X,%02X,%02X erase=%lums prog=%lums read=%lums\r\n",
             (unsigned int)sr[0], (unsigned int)sr[1], (unsigned int)sr[2],
             (unsigned long)eraseMs, (unsigned long)progMs, (unsigned long)readMs);
    uart_send(inst, buf);
}

#endif /* QSPI_TEST_FEATURE_ENABLED */

/* --------------------------------------------------------------------------
 * DIAGnostic:OPTBytes? / DIAGnostic:RSTCause? / DIAGnostic:RSTCause:CLEar
 *
 * Boot diagnostics, ported from WHAM-XREX-PFMG474 (added 2026-09-29).
 * OPTBytes? reports the LIVE FLASH_OPTR register and the three bits that
 * decide the boot source (nBOOT0, nSWBOOT0, nBOOT1). RSTCause? reports the
 * RCC->CSR reset-cause flags (BOR brown-out/power-on, PIN NRST, SFT
 * software, IWDG/WWDG watchdog, LPWR low-power, OBL option-byte reload).
 * The boot banner (boot_diag.c) already captures and clears these each boot,
 * so RSTCause? mostly shows resets since then; CLEar zeroes the flags.
 * -------------------------------------------------------------------------- */
void cmd_diag_optbytes_query(uart_instance_t *inst, char *args)
{
    char buf[96];
    mcu_option_bytes_t ob;
    (void)args;

    Mcu_ReadOptionBytes(&ob);
    snprintf(buf, sizeof(buf), "OK OPTR=%08lX nBOOT0=%u nSWBOOT0=%u nBOOT1=%u\r\n",
             (unsigned long)ob.raw, (unsigned)ob.nBoot0, (unsigned)ob.nSwBoot0,
             (unsigned)ob.nBoot1);
    uart_send(inst, buf);
}

void cmd_diag_rstcause_query(uart_instance_t *inst, char *args)
{
    char buf[160];
    int  len = 0;
    mcu_reset_flags_t f;
    (void)args;

    Mcu_ReadResetFlags(&f);
    len += snprintf(&buf[len], sizeof(buf) - (size_t)len, "OK CSR=%08lX", (unsigned long)f.raw);
    len += snprintf(&buf[len], sizeof(buf) - (size_t)len, " BOR=%u",   (unsigned)f.bor);
    len += snprintf(&buf[len], sizeof(buf) - (size_t)len, " PIN=%u",   (unsigned)f.pin);
    len += snprintf(&buf[len], sizeof(buf) - (size_t)len, " SFT=%u",   (unsigned)f.sft);
    len += snprintf(&buf[len], sizeof(buf) - (size_t)len, " IWDG=%u",  (unsigned)f.iwdg);
    len += snprintf(&buf[len], sizeof(buf) - (size_t)len, " WWDG=%u",  (unsigned)f.wwdg);
    len += snprintf(&buf[len], sizeof(buf) - (size_t)len, " LPWR=%u",  (unsigned)f.lpwr);
    len += snprintf(&buf[len], sizeof(buf) - (size_t)len, " OBL=%u",   (unsigned)f.obl);
    snprintf(&buf[len], sizeof(buf) - (size_t)len, "\r\n");
    uart_send(inst, buf);
}

void cmd_diag_rstcause_clear(uart_instance_t *inst, char *args)
{
    (void)args;
    Mcu_ClearResetFlags();   /* resets every flag above to 0 */
    Scpi_ReplyOk(inst);
}

/* --------------------------------------------------------------------------
 * SYS:ID? -- OK serial=<sn> uid=<24 hex> flashuid=<16 hex> product=<name> hw=<rev> fw=<version> commit=<hash> label=<text> verified=<0|1>
 *
 * Which physical board this is (device_identity.h; design in
 * docs/device_identity_and_host_service.md at the top of the repository). One line of
 * key=value fields: a host reads fields by key, so new ones can be added at the end.
 * `serial` is UNSET and `verified` 0 until a serial is provisioned. `uid` is the
 * MCU's factory unique ID, `flashuid` the flash chip's (0000000000000000 if the chip
 * did not answer). Identical in both products.
 * -------------------------------------------------------------------------- */
void cmd_sys_id_query(uart_instance_t *inst, char *args)
{
    char buf[224];
    char body[200];
    (void)args;

    (void)DeviceIdentity_FormatId(body, sizeof(body), HW_BOARD_NAME, HW_BOARD_REV, FW_VERSION_STRING,
                                  (FW_GIT_DIRTY != 0U) ? FW_GIT_COMMIT "-dirty" : FW_GIT_COMMIT);
    snprintf(buf, sizeof(buf), "OK %s\r\n", body);
    uart_send(inst, buf);
}


/* --------------------------------------------------------------------------
 * SYS:SERial <sn> / SYS:SERial? / SYS:LABel <text> / SYS:LABel? / SYS:ID:CLEar CONFIRM
 *
 * Provisioning of the board's identity (device_identity.h; design in
 * docs/device_identity_and_host_service.md at the top of the repository). The serial is written ONCE
 * into the identity region of the external flash and bound to this MCU and this flash chip; it is
 * refused while one exists (ERR 19) -- clear it first. The label is an optional token (A-Z a-z 0-9 . _ -,
 * up to 32 characters, "-" clears it) and needs a serial. Changes write flash, which stalls the
 * command link for tens of milliseconds, so they are accepted only while IDLE (ERR 13), like *SAV.
 * Identical in both products.
 * -------------------------------------------------------------------------- */
static uint8_t IdentityWritable(uart_instance_t *inst)
{
    if (SM_GetState() != SM_STATE_IDLE)
    {
        Scpi_SendErr(inst, ERR_INVALID_STATE, "identity can be changed only while IDLE");
        return 0U;
    }
    return 1U;
}

static void IdentityReply(uart_instance_t *inst, devid_result_t r)
{
    switch (r)
    {
        case DEVID_OK:
            Scpi_ReplyOk(inst);
            break;
        case DEVID_ERR_BAD_SERIAL:
            Scpi_SendErr(inst, ERR_INVALID_ARGS, "serial must be 3-16 characters of A-Z 0-9 -");
            break;
        case DEVID_ERR_BAD_LABEL:
            Scpi_SendErr(inst, ERR_INVALID_ARGS, "label must be 1-32 characters of A-Z a-z 0-9 . _ - (- clears it)");
            break;
        case DEVID_ERR_ALREADY_SET:
            Scpi_SendErr(inst, ERR_IDENTITY, "a serial is already provisioned (SYS:ID:CLEar CONFIRM first)");
            break;
        case DEVID_ERR_NOT_SET:
            Scpi_SendErr(inst, ERR_IDENTITY, "no serial is provisioned (SYS:SERial first)");
            break;
        case DEVID_ERR_NO_HWID:
            Scpi_SendErr(inst, ERR_QSPI_FAILED, "the flash chip's unique ID could not be read");
            break;
        default:
            Scpi_SendErr(inst, ERR_QSPI_FAILED, "external flash write failed");
            break;
    }
}

/* One whole-token argument and nothing after it; NULL (reply sent) otherwise. */
static char *IdentityArg(uart_instance_t *inst, char *args, const char *usage)
{
    char *tok = (args != NULL) ? strtok(args, " \r\n") : NULL;

    if ((tok == NULL) || (strtok(NULL, " \r\n") != NULL))
    {
        Scpi_SendErr(inst, ERR_INVALID_ARGS, usage);
        return NULL;
    }
    return tok;
}

void cmd_sys_serial(uart_instance_t *inst, char *args)
{
    char *tok = IdentityArg(inst, args, "SYS:SERial needs one argument: the serial number");

    if ((tok != NULL) && (IdentityWritable(inst) != 0U))
    {
        IdentityReply(inst, DeviceIdentity_SetSerial(tok));
    }
}

void cmd_sys_serial_query(uart_instance_t *inst, char *args)
{
    char buf[40];
    (void)args;

    snprintf(buf, sizeof(buf), "OK %s\r\n", DeviceIdentity_Serial());
    uart_send(inst, buf);
}

void cmd_sys_label(uart_instance_t *inst, char *args)
{
    char *tok = IdentityArg(inst, args, "SYS:LABel needs one argument: the label (- clears it)");

    if ((tok != NULL) && (IdentityWritable(inst) != 0U))
    {
        IdentityReply(inst, DeviceIdentity_SetLabel(tok));
    }
}

void cmd_sys_label_query(uart_instance_t *inst, char *args)
{
    char buf[48];
    const char *label = DeviceIdentity_Label();
    (void)args;

    snprintf(buf, sizeof(buf), "OK %s\r\n", (label[0] != '\0') ? label : "-");
    uart_send(inst, buf);
}

void cmd_sys_id_clear(uart_instance_t *inst, char *args)
{
    char *tok = IdentityArg(inst, args, "SYS:ID:CLEar needs the word CONFIRM");

    if (tok == NULL)
    {
        return;
    }
    if (strcmp(tok, "CONFIRM") != 0)
    {
        Scpi_SendErr(inst, ERR_INVALID_ARGS, "SYS:ID:CLEar needs the word CONFIRM");
        return;
    }
    if (IdentityWritable(inst) != 0U)
    {
        IdentityReply(inst, DeviceIdentity_Clear());
    }
}
