/*
 * cmd_system.c -- serial command handlers: *IDN?, BOOT, QSPI:ID?, QSPI:SELFtest.
 * Split out of the old single commands.c (2026-09-29); the handlers are
 * unchanged. See commands.h for the file map.
 */
#include "commands.h"
#include "cmd_common.h"
#include "ctrlr_config.h"
#include "boot_jump.h"
#include "qspi_test.h"
#include "nvstore.h"
#include "git_version.h"
#include "mcu.h"
#include "state_machine.h"
#include <stdio.h>
#include <stdlib.h>
#include <string.h>

/* --------------------------------------------------------------------------
 * Identification / system
 * -------------------------------------------------------------------------- */

void cmd_idn(uart_instance_t *inst, char *args)
{
    char buf[96];
    (void)args;

    /* Board + firmware identity in one line, matching the sibling
       PFM-STM32G474 project's *IDN convention (OK <value>, space-
       separated fields) -- see ctrlr_config.h for the constants.

       4th field, FW_GIT_COMMIT (added 2026-09-29, ported from
       WHAM-XREX-PFMG474): exactly which git commit THIS firmware was
       built from, so a host can always tell what is really running on a
       board. A `-dirty` suffix flags a build made with uncommitted
       changes. Generated by python/gen_git_version.py (run by
       python/wham_build.py) into build/generated/git_version.h. */
    snprintf(buf, sizeof(buf), "OK %s %s %s %s%s\r\n",
             HW_BOARD_NAME, HW_BOARD_REV, FW_VERSION_STRING,
             FW_GIT_COMMIT, (FW_GIT_DIRTY != 0U) ? "-dirty" : "");
    uart_send(inst, buf);
}

#if (BOOT_JUMP_FEATURE_ENABLED != 0)
void cmd_boot(uart_instance_t *inst, char *args)
{
    (void)args;

    /* Refused while ARMED or FIRING (ERR 13): resetting into the ROM
       bootloader under load would drop the outputs uncontrolled. Allowed in
       IDLE and FAULT (a faulted board may need new firmware). */
    if ((SM_GetState() == SM_STATE_ARMED) || (SM_GetState() == SM_STATE_FIRING))
    {
        SendErr(inst, ERR_INVALID_STATE, "BOOT refused while ARMED or FIRING -- DISARM first");
        return;
    }

    /* uart_send() is blocking (HAL_UART_Transmit with HAL_MAX_DELAY), so
       this ACK is guaranteed to be fully on the wire before
       BootJump_RequestBootloader() resets the MCU below -- the operator
       (or a flashing script) sees "OK ENTERING BOOTLOADER" before the
       link drops. */
    uart_send(inst, "OK ENTERING BOOTLOADER\r\n");

    BootJump_RequestBootloader();
    /* Never returns. */
}
#endif /* BOOT_JUMP_FEATURE_ENABLED */

#if (QSPI_TEST_FEATURE_ENABLED != 0)
/* --------------------------------------------------------------------------
 * QSPI:ID?
 *
 * QUADSPI connectivity test against the W25Q128JVS wired to
 * PE12-PE15/PB10-PB11 (docs/pin_mapping_v4.csv) -- issues the flash's
 * standard JEDEC Read ID instruction (0x9F, plain 1-line mode, no Quad
 * Enable required) via QspiTest_ReadId() (qspi_test.h) and reports the
 * 3 raw bytes (Manufacturer, Memory Type, Capacity) as space-separated
 * uppercase hex, e.g. "OK EF 40 18" for a healthy Winbond part --
 * compare against the W25Q128JVS datasheet's own JEDEC ID table rather
 * than trusting any specific expected value hardcoded here (none is;
 * this command reports what the chip actually says, nothing assumed).
 * ERR 7 on any HAL_QSPI command/receive failure or timeout (e.g. no
 * chip present, a wiring fault, or the bus wedged) -- see
 * QspiTest_ReadId()'s own doc comment for exactly what that call does
 * and does not verify.
 * -------------------------------------------------------------------------- */
void cmd_qspi_id(uart_instance_t *inst, char *args)
{
    uint8_t id[3];
    char buf[32];
    (void)args;

    if (QspiTest_ReadId(id) == 0U)
    {
        SendErr(inst, ERR_QSPI_FAILED, "QUADSPI command failed or timed out");
        return;
    }

    snprintf(buf, sizeof(buf), "OK %02X %02X %02X\r\n",
             (unsigned int)id[0], (unsigned int)id[1], (unsigned int)id[2]);
    uart_send(inst, buf);
}
/* --------------------------------------------------------------------------
 * QSPI:SELFtest
 *
 * Bench proof of the external-flash storage driver (nvstore.h) against the
 * real W25Q128JVS, added 2026-09-29 before anything is built on top of it.
 * An action, not a query (it erases and programs), so no '?'. Works only on
 * the reserved scratch sector (NVSTORE_SCRATCH_ADDR, last sector of the
 * chip) and leaves it erased. IDLE only: a sector erase blocks the main loop
 * (serial link included) for tens of milliseconds.
 *
 * Steps: read the three status registers; erase the sector (the driver
 * checks it reads back blank); program a 300-byte pattern that starts
 * mid-page and crosses a 256-byte page boundary; read it back and compare;
 * read the WHOLE sector and check every byte outside the pattern is still
 * 0xFF (catches a page program that wrapped around inside its page and
 * clobbered earlier bytes); erase again.
 *
 * Reply: "OK PASS sr=<SR1>,<SR2>,<SR3> erase=<ms> prog=<ms> read=<ms>" (hex
 * status registers; times from the 1 ms tick, so +-1 ms), or
 * "ERR 7 selftest <step>: <reason>" naming the first step that failed.
 * ERR 13 if not IDLE.
 * -------------------------------------------------------------------------- */
#define SELFTEST_PATTERN_OFFSET   (200U)   /* 200..499: crosses the 256-byte page boundary */
#define SELFTEST_PATTERN_LEN      (300U)
#define SELFTEST_READ_CHUNK       (256U)

static uint8_t SelftestPatternByte(uint32_t i)
{
    return (uint8_t)((i * 7U) + 0x5AU);
}

static void SelftestFail(uart_instance_t *inst, const char *step, nvstore_status_t st)
{
    char msg[64];

    snprintf(msg, sizeof(msg), "selftest %s: %s", step, NvStore_StatusText(st));
    SendErr(inst, ERR_QSPI_FAILED, msg);
}

void cmd_qspi_selftest(uart_instance_t *inst, char *args)
{
    uint8_t pattern[SELFTEST_PATTERN_LEN];
    uint8_t chunk[SELFTEST_READ_CHUNK];
    uint8_t sr[3];
    uint32_t t0;
    uint32_t eraseMs;
    uint32_t progMs;
    uint32_t readMs;
    char buf[96];
    nvstore_status_t st;
    (void)args;

    if (SM_GetState() != SM_STATE_IDLE)
    {
        SendErr(inst, ERR_INVALID_STATE, "QSPI:SELFtest only in IDLE");
        return;
    }

    if ((st = NvStore_ReadStatusRegs(sr)) != NVSTORE_OK)
    {
        SelftestFail(inst, "status", st);
        return;
    }

    t0 = Mcu_GetTickMs();
    if ((st = NvStore_EraseSector(NVSTORE_SCRATCH_ADDR)) != NVSTORE_OK)
    {
        SelftestFail(inst, "erase", st);
        return;
    }
    eraseMs = Mcu_GetTickMs() - t0;

    for (uint32_t i = 0U; i < SELFTEST_PATTERN_LEN; i++)
    {
        pattern[i] = SelftestPatternByte(i);
    }
    t0 = Mcu_GetTickMs();
    if ((st = NvStore_Program(NVSTORE_SCRATCH_ADDR + SELFTEST_PATTERN_OFFSET, pattern,
                              SELFTEST_PATTERN_LEN)) != NVSTORE_OK)
    {
        SelftestFail(inst, "program", st);
        return;
    }
    progMs = Mcu_GetTickMs() - t0;

    /* Read the whole sector back, independently of the driver's own
       verify: the pattern where it belongs, 0xFF everywhere else. */
    t0 = Mcu_GetTickMs();
    for (uint32_t off = 0U; off < NVSTORE_SECTOR_BYTES; off += SELFTEST_READ_CHUNK)
    {
        if ((st = NvStore_Read(NVSTORE_SCRATCH_ADDR + off, chunk, SELFTEST_READ_CHUNK)) != NVSTORE_OK)
        {
            SelftestFail(inst, "read", st);
            return;
        }
        for (uint32_t i = 0U; i < SELFTEST_READ_CHUNK; i++)
        {
            uint32_t pos = off + i;
            uint8_t want = 0xFFU;

            if (pos >= SELFTEST_PATTERN_OFFSET && pos < (SELFTEST_PATTERN_OFFSET + SELFTEST_PATTERN_LEN))
            {
                want = SelftestPatternByte(pos - SELFTEST_PATTERN_OFFSET);
            }
            if (chunk[i] != want)
            {
                snprintf(buf, sizeof(buf), "selftest compare: offset %u is %02X, expected %02X",
                         (unsigned int)pos, (unsigned int)chunk[i], (unsigned int)want);
                SendErr(inst, ERR_QSPI_FAILED, buf);
                return;
            }
        }
    }
    readMs = Mcu_GetTickMs() - t0;

    if ((st = NvStore_EraseSector(NVSTORE_SCRATCH_ADDR)) != NVSTORE_OK)
    {
        SelftestFail(inst, "final erase", st);
        return;
    }

    snprintf(buf, sizeof(buf), "OK PASS sr=%02X,%02X,%02X erase=%lums prog=%lums read=%lums\r\n",
             (unsigned int)sr[0], (unsigned int)sr[1], (unsigned int)sr[2],
             (unsigned long)eraseMs, (unsigned long)progMs, (unsigned long)readMs);
    uart_send(inst, buf);
}

#endif /* QSPI_TEST_FEATURE_ENABLED */

/* --------------------------------------------------------------------------
 * DIAGnostic:OPTBytes? / DIAGnostic:RSTCause? / DIAGnostic:RSTCause:CLEar
 *
 * Boot diagnostics, ported from WHAM-XREX-PFMG474 (added 2026-09-29).
 * OPTBytes? reports the LIVE FLASH_OPTR register and the three bits that
 * decide the boot source (nBOOT0, nSWBOOT0, nBOOT1). RSTCause? reports the
 * RCC->CSR reset-cause flags (BOR brown-out/power-on, PIN NRST, SFT
 * software, IWDG/WWDG watchdog, LPWR low-power, OBL option-byte reload).
 * The boot banner (boot_diag.c) already captures and clears these each boot,
 * so RSTCause? mostly shows resets since then; CLEar zeroes the flags.
 * -------------------------------------------------------------------------- */
void cmd_diag_optbytes_query(uart_instance_t *inst, char *args)
{
    char buf[96];
    mcu_option_bytes_t ob;
    (void)args;

    Mcu_ReadOptionBytes(&ob);
    snprintf(buf, sizeof(buf), "OK OPTR=%08lX nBOOT0=%u nSWBOOT0=%u nBOOT1=%u\r\n",
             (unsigned long)ob.raw, (unsigned)ob.nBoot0, (unsigned)ob.nSwBoot0,
             (unsigned)ob.nBoot1);
    uart_send(inst, buf);
}

void cmd_diag_rstcause_query(uart_instance_t *inst, char *args)
{
    char buf[160];
    int  len = 0;
    mcu_reset_flags_t f;
    (void)args;

    Mcu_ReadResetFlags(&f);
    len += snprintf(&buf[len], sizeof(buf) - (size_t)len, "OK CSR=%08lX", (unsigned long)f.raw);
    len += snprintf(&buf[len], sizeof(buf) - (size_t)len, " BOR=%u",   (unsigned)f.bor);
    len += snprintf(&buf[len], sizeof(buf) - (size_t)len, " PIN=%u",   (unsigned)f.pin);
    len += snprintf(&buf[len], sizeof(buf) - (size_t)len, " SFT=%u",   (unsigned)f.sft);
    len += snprintf(&buf[len], sizeof(buf) - (size_t)len, " IWDG=%u",  (unsigned)f.iwdg);
    len += snprintf(&buf[len], sizeof(buf) - (size_t)len, " WWDG=%u",  (unsigned)f.wwdg);
    len += snprintf(&buf[len], sizeof(buf) - (size_t)len, " LPWR=%u",  (unsigned)f.lpwr);
    len += snprintf(&buf[len], sizeof(buf) - (size_t)len, " OBL=%u",   (unsigned)f.obl);
    snprintf(&buf[len], sizeof(buf) - (size_t)len, "\r\n");
    uart_send(inst, buf);
}

void cmd_diag_rstcause_clear(uart_instance_t *inst, char *args)
{
    (void)args;
    Mcu_ClearResetFlags();   /* resets every flag above to 0 */
    uart_send(inst, "OK\r\n");
}
